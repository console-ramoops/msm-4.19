## drivers/oplus/Kconfig
```kconfig
# SPDX-License-Identifier: GPL-2.0-only
menuconfig OPLUS_FEATURE
	bool "OPLUS Features"
	default y
	help
	  Framework and telemetry support for OPlus / ColorOS / OxygenOS systems.

if OPLUS_FEATURE

config OPLUS_HEALTHINFO
	bool "OPLUS Healthinfo and Resource Telemetry"
	default y
	help
	  Exposes real-time CPU loading and latency statistics under
	  /proc/oplus_healthinfo to satisfy ColorOS Trinity Engine and
	  PerformanceService.

config OPLUS_JANK_INFO
	bool "OPLUS CPU Jank and Core Load Monitoring"
	default y
	help
	  Provides /proc/jank_info/cpu_jank_info for FrameBoost heuristics
	  and core load tracking.

config OPLUS_THEIA
	bool "OPLUS Theia Stability and Project Telemetry"
	default y
	help
	  Provides /proc/theiaPwkReport and /proc/oplusVersion nodes with
	  dynamic project name discovery.

config OPLUS_AFS_CONFIG
	bool "OPLUS Anti-Freeze Service Config"
	default y
	help
	  Provides /proc/oplus_afs_config for Athena anti-freeze policy buffers.

config OPLUS_NANDSWAP
	bool "OPLUS Virtual zRAM-backed NANDswap Interface"
	default y
	help
	  Provides /proc/nandswap and /proc/nandswap_vnd interfaces required by
	  ColorOS / OxygenOS RAM Expansion framework, routing swap data cleanly
	  into compressed zRAM without wear on eMMC storage.

endif
```
